## apps/terrarium/Groupe_H/Kconfig
```kconfig
#
# For a description of the syntax of this configuration file,
# see misc/tools/kconfig-language.txt.
#

config APPLICATION_GROUPE_H
	bool "Groupe H application"
	default n
	---help---
		Enable the Groupe H application

if APPLICATION_GROUPE_H

config APPLICATION_GROUPE_A_PROGNAME
	string "Program name"
	default "Application du groupe H"
	depends on BUILD_KERNEL
	---help---
		Basic application for terrarium students.
endif
```

## myapp/Groupe_H/apps/examples/esp8266/Kconfig
```kconfig
#
# For a description of the syntax of this configuration file,
# see misc/tools/kconfig-language.txt.
#

config EXAMPLES_ESP8266
	bool "ESP8266 application"
	default n
	---help---
		Enable the \"esp8266\" example

if EXAMPLES_ESP8266
endif
```
